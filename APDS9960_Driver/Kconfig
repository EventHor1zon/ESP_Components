## APDS9960_Driver/Kconfig
```kconfig
menu "APDS9960 Driver Config"

    config RANDOM_OPTION_HERE
        bool "random option"
        default FALSE
        help
            "Wonder if this works?"

endmenu
```

## BME280_Driver/Kconfig
```kconfig
menu "BM280 Driver"

    config BME_280
        bool "Enable BME280 Functions"
        default y
        help
            Build the driver with support for BME280 rather
            than the BMP280. This adds functions to measure
             humidity.

endmenu
```

## FutabaVFD_Driver/Kconfig
```kconfig
menu "Futaba VFD Driver"
    
    config CONFIG_FVFDRIVER_DISPLAY_HEIGHT
        int "Display height"
        default 1
        help
            "Number of rows of segments. This 
            driver only supports 1 row I think."

    config CONFIG_FVFD_DISPLAY_WIDTH
        int "Display Width"
        default 8
        help
            "Currently only 8 and 16 segments are supported"

endmenu
```

## Kconfig.projbuild
```kconfig
menu "ESP32 Component Configuration"

    config ENABLE_MAX31_EVENTS
        bool "Enable Max30102 events"
        default FALSE
        help
            Enables the max31 events (requires a running event loop)

endmenu
```

## LoraSX1276_Driver/Kconfig
```kconfig
menu "Lora SX2876"

    config CONFIG_LORASX_ENABLE_FSK
        bool "Enable FSK radio"
        default FALSE
        help
            "Compile functions for FSK radio mode"

    config CONFIG_LORASX_SPI_DEBUG
        bool "Enable SPI debug output"
        default FALSE
        help
            "Enable spi debug output messages"

endmenu
```
